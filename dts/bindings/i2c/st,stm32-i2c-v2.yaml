## dts/bindings/i2c/st,stm32-i2c-v2.yaml
```yaml
# Copyright (c) 2017 I-SENSE group of ICCS
# SPDX-License-Identifier: Apache-2.0

description: STM32 I2C V2 controller

compatible: "st,stm32-i2c-v2"

include: i2c-controller.yaml

properties:
    reg:
      required: true

    interrupts:
      required: true

    timing:
        type: int
        required: false
        description: optional a pre-computed I2C_TIMINGR value to override runtime timing calculation
```
